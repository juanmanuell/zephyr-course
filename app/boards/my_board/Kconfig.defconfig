## app/boards/my_board/Kconfig.defconfig
```kconfig
# My Board from Scratch configuration

# Copyright (c) 2023 Thomas Stranger
# SPDX-License-Identifier: Apache-2.0

if BOARD_MY_BOARD

configdefault NET_L2_ETHERNET
	default y

endif # BOARD_MY_BOARD
```

## app/boards/my_board/board.yml
```yaml
board:
  name: my_board
  full_name: My Board from Scratch
  vendor: juan manuel
  socs:
    - name: stm32h563xx
```

## app/boards/our_board/board.yml
```yaml
board:
  name: our_board
  full_name: Our Board
  vendor: juan manuel
  socs:
    - name: stm32h563xx
```

## app/modules/our_drivers/drivers/led_sensor/Kconfig
```kconfig
# SPDX-License-Identifier: Apache-2.0

config OUR_LED_SENSOR
	bool "LED sensor driver"
	default y
	depends on DT_HAS_OUR_LED_SENSOR_ENABLED
	depends on SENSOR
	select GPIO
	help
	  Enable the sensor driver backed by an on-board LED. Fetching a
	  sample turns the LED on and reading the channel turns it off.
```

## app/modules/our_drivers/dts/bindings/sensor/our,led-sensor.yaml
```yaml
# SPDX-License-Identifier: Apache-2.0

description: Simple sensor backed by an on-board LED

compatible: "our,led-sensor"

include: sensor-device.yaml

properties:
  gpios:
    type: phandle-array
    required: true
    description: GPIO connected to the LED used by the sensor
```
